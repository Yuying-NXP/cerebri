## west.yml
```yaml
# Copyright (c) 2023 CogniPilot Foundation
# SPDX-License-Identifier: Apache-2.0

manifest:

  group-filter:
    - +optional

  self:
    west-commands: scripts/west-commands.yml

  remotes:
    - name: zephyrproject-rtos
      url-base: https://github.com/zephyrproject-rtos
    - name: cognipilot
      url-base: https://github.com/CogniPilot
    - name: yuying-nxp
      url-base: https://github.com/Yuying-NXP

  projects:
    - name: zephyr
      remote: cognipilot
      west-commands: scripts/west-commands.yml
      revision: 5d773cd0a9b63ba55ff51ecdd4ddb4db89c5226d # main-with-patches-yuying 22/05/26
      import:
        - name-allowlist:
          - nanopb
          - mbedtls
          - hal_nxp
          - cmsis
          - cmsis-dsp
          - cmsis_6
          - fatfs
          - open-amp
          - libmetal
          - segger
    - name: zros
      remote: cognipilot
      revision: 843348bca3a15e914914b90057369b9616302e20 # main 10/27/25
      path: modules/lib/zros
    - name: cyecca
      remote: cognipilot
      revision: 64d1f0dc5127d85765909f0c3525cc38305dac19 # main 11/17/25
      path: modules/lib/cyecca
    - name: synapse_pb
      remote: cognipilot
      revision: f038dd178faac0481033e5e4c757e31777c1b0be # main 11/10/25
      path: modules/lib/synapse_pb
    - name: zros_drivers
      remote: yuying-nxp
      revision: 32d7acf82500580f470328eab5378c5ecb6246a5 # yuying_filter, with LPF, calibration, and welford's algorithm
      path: modules/lib/zros_drivers
    - name: zephyr_boards
      remote: cognipilot
      revision: f3aec493d95570392e8816947161691fdb2c17cf # main 03/27/27
      path: modules/lib/zephyr_boards
```
